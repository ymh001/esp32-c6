## firmware/desk-clock/main/Kconfig.projbuild
```kconfig
menu "Desk clock diagnostics"
config DESK_CLOCK_UI_SELF_TEST
    bool "Run UI stress test at boot"
    default n
    help
        Exercise brightness, page navigation, all screens and rotations.
        Restores the loaded settings after the test. Disable for normal use.
endmenu
```

## firmware/desk-clock/sdkconfig.defaults
```kconfig
CONFIG_IDF_TARGET="esp32c6"

CONFIG_ESPTOOLPY_FLASHSIZE_16MB=y
CONFIG_ESPTOOLPY_FLASHMODE_DIO=y
CONFIG_ESPTOOLPY_FLASHFREQ_40M=y
CONFIG_PARTITION_TABLE_CUSTOM=y
CONFIG_PARTITION_TABLE_CUSTOM_FILENAME="partitions.csv"

CONFIG_COMPILER_OPTIMIZATION_PERF=y
CONFIG_FREERTOS_HZ=1000
CONFIG_LOG_COLORS=y

CONFIG_LWIP_SNTP_MAX_SERVERS=2
CONFIG_LWIP_MAX_SOCKETS=16
CONFIG_HTTPD_MAX_REQ_HDR_LEN=1024

# UI screens and draw-task bursts need more than LVGL's 64 KiB default.
CONFIG_LV_MEM_SIZE_KILOBYTES=96
```

## firmware/pocket-home/sdkconfig.defaults
```kconfig
CONFIG_IDF_TARGET="esp32c6"
CONFIG_ESPTOOLPY_FLASHSIZE_16MB=y
CONFIG_ESPTOOLPY_FLASHMODE_DIO=y
CONFIG_ESPTOOLPY_FLASHFREQ_40M=y
CONFIG_PARTITION_TABLE_CUSTOM=y
CONFIG_PARTITION_TABLE_CUSTOM_FILENAME="partitions.csv"
CONFIG_COMPILER_OPTIMIZATION_PERF=y
CONFIG_FREERTOS_HZ=1000
CONFIG_ESP_MAIN_TASK_STACK_SIZE=12288
CONFIG_LWIP_SNTP_MAX_SERVERS=2
CONFIG_LV_MEM_SIZE=65536
CONFIG_LV_FONT_FMT_TXT_LARGE=y
CONFIG_LV_FONT_MONTSERRAT_24=y
CONFIG_LV_FONT_MONTSERRAT_32=y
CONFIG_LV_USE_SYSMON=n
CONFIG_ESP_TASK_WDT_PANIC=y

CONFIG_LV_BUILD_EXAMPLES=n
CONFIG_ESP_CONSOLE_USB_SERIAL_JTAG=y

CONFIG_MBEDTLS_CERTIFICATE_BUNDLE=y

CONFIG_FATFS_LFN_HEAP=y
CONFIG_FATFS_MAX_LFN=255
CONFIG_FATFS_API_ENCODING_UTF_8=y
CONFIG_PM_ENABLE=y

CONFIG_HTTPD_MAX_URI_LEN=1024
```
